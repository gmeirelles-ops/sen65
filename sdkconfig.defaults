## sdkconfig.defaults
```kconfig
CONFIG_LWIP_PPP_SUPPORT=y
CONFIG_LWIP_PPP_PAP_SUPPORT=y
CONFIG_LWIP_TCPIP_TASK_STACK_SIZE=4096
CONFIG_LWIP_PPP_ENABLE_IPV6=n
CONFIG_UART_ISR_IN_IRAM=y
# Enable NAPT
CONFIG_LWIP_IP_FORWARD=y
CONFIG_LWIP_IPV4_NAPT=y

# BluFi (BLE) para configurar Wi-Fi — app EspBlufi (Bluedroid)
CONFIG_BT_ENABLED=y
CONFIG_BTDM_CTRL_MODE_BLE_ONLY=y
CONFIG_BT_BLUEDROID_ENABLED=y
CONFIG_BT_BLE_BLUFI_ENABLE=y
CONFIG_BT_BLE_42_FEATURES_SUPPORTED=y
CONFIG_MBEDTLS_DHM_C=y

# Sensor SEN65: sem Ethernet / codec audio
CONFIG_ETH_ENABLED=n

# Mais espaço para app com BT + MQTT (idf.py fullclean após mudar)
CONFIG_PARTITION_TABLE_SINGLE_APP_LARGE=y
```
